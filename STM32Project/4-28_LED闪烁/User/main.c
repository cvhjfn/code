/**
 * @file    main.c
 * @brief   STM32F103C8T6 LED闪烁实验 - 主程序
 * @date    2026-04-28
 * 
 * @details 本程序实现STM32F103C8T6微控制器控制PA0引脚上的LED灯
 *          以固定频率闪烁。通过配置GPIO推挽输出模式，结合软件
 *          延时函数，实现LED的亮灭循环。
 * 
 * 硬件连接:
 *          - PA0 引脚连接LED（低电平点亮/高电平熄灭）
 * 
 * 时钟配置:
 *          - 系统时钟: 72MHz (使用外部8MHz晶振，经PLL倍频)
 *          - APB2总线时钟: 72MHz (GPIOA挂载在APB2总线上)
 */

/* ========================== 头文件包含 ========================== */
#include "stm32f10x.h"              /* STM32F10x标准外设库主头文件 */

/* ========================== 函数声明 ========================== */
void Delay_ms(uint32_t ms);         /* 毫秒级延时函数 */

/* ==================================================================
 * 函数名称: main
 * 函数功能: 程序入口，初始化外设并进入LED闪烁主循环
 * 参数说明: 无
 * 返 回 值: int (通常不会返回)
 * ================================================================== */
int main(void)
{
    /* ---------- 步骤1：使能GPIOA外设时钟 ----------
     * STM32上电后，各外设时钟默认关闭以降低功耗。
     * 使用GPIO前必须先使能其对应的时钟。
     * GPIOA挂载在APB2高速总线上，因此调用RCC_APB2PeriphClockCmd。
     */
    RCC_APB2PeriphClockCmd(RCC_APB2Periph_GPIOA, ENABLE);

    /* ---------- 步骤2：配置GPIOA引脚参数 ----------
     * 定义一个GPIO_InitTypeDef类型的结构体变量，
     * 用于配置GPIO引脚的工作模式、速度和引脚号。
     * GPIO_InitTypeDef结构体包含三个成员:
     *   - GPIO_Pin:   指定要配置的引脚（可组合多个引脚，如GPIO_Pin_0 | GPIO_Pin_1）
     *   - GPIO_Mode:  指定引脚工作模式（输入/输出/复用/模拟）
     *   - GPIO_Speed: 指定引脚最大输出速率（仅输出模式有效）
     */
    GPIO_InitTypeDef GPIO_InitStructure;

    /* 选择PA0引脚（GPIO_Pin_0 对应第0号引脚）*/
    GPIO_InitStructure.GPIO_Pin = GPIO_Pin_0;

    /* 设置为推挽输出模式 (Push-Pull Output)
     * 推挽输出可以主动输出高电平和低电平，驱动能力较强，
     * 适合驱动LED、继电器等外部器件。
     * 其他常见模式: GPIO_Mode_Out_OD (开漏输出)、GPIO_Mode_IN_FLOATING (浮空输入)等
     */
    GPIO_InitStructure.GPIO_Mode = GPIO_Mode_Out_PP;

    /* 设置引脚最大输出速率为50MHz
     * STM32F103的GPIO输出速率可选: 2MHz / 10MHz / 50MHz
     * 对于LED闪烁这种低速应用，2MHz已足够，这里设置为50MHz以兼容高速场景。
     */
    GPIO_InitStructure.GPIO_Speed = GPIO_Speed_50MHz;

    /* ---------- 步骤3：调用GPIO_Init函数将配置写入寄存器 ----------
     * 该函数根据GPIO_InitStructure中的配置，
     * 设置GPIOA的CRL/CRH（端口配置寄存器），完成硬件初始化。
     */
    GPIO_Init(GPIOA, &GPIO_InitStructure);

    /* ==================== 主循环 ====================
     * 无限循环，实现LED持续闪烁。
     * 嵌入式系统中的main函数不允许返回，必须有一个死循环。
     */
    while(1)
    {
        /* ----- LED点亮 -----
         * GPIO_ResetBits: 将指定引脚拉低（输出0）
         * 假设LED阳极接VCC，阴极经限流电阻接PA0，
         * 则PA0输出低电平时LED两端有压差，LED点亮。
         */
        GPIO_ResetBits(GPIOA, GPIO_Pin_0);

        /* 延时约500毫秒，保持LED点亮状态 */
        Delay_ms(500);

        /* ----- LED熄灭 -----
         * GPIO_SetBits: 将指定引脚拉高（输出1）
         * PA0输出高电平时LED两端无压差，LED熄灭。
         */
        GPIO_SetBits(GPIOA, GPIO_Pin_0);

        /* 延时约500毫秒，保持LED熄灭状态 */
        Delay_ms(500);

        /* 循环往复，实现LED以约1Hz的频率闪烁（亮500ms + 灭500ms = 1s周期）*/
    }
}

/* ==================================================================
 * 函数名称: Delay_ms
 * 函数功能: 基于软件循环的毫秒级延时函数
 * 参数说明: ms - 需要延时的毫秒数
 * 返 回 值: 无
 * 
 * 实现原理:
 *   通过嵌套for循环执行空操作（NOP），消耗CPU周期来实现延时。
 *   延时时间 = 循环次数 × 单次循环耗时。
 *   
 *   单次循环耗时 = (内层循环体指令周期数) / 系统时钟频率
 *   例如: 系统时钟72MHz，内层循环体约6个指令周期，
 *         则单次循环耗时 ≈ 6 / 72MHz ≈ 83ns
 *         外层循环10000次 → 约0.83ms
 *         再乘以内层循环的调整系数即可得到约1ms的延时。
 *   
 * 注意事项:
 *   - 软件延时精度较低，受编译器优化等级和中断影响。
 *   - 如需精确定时，建议使用SysTick定时器或硬件定时器。
 *   - 不同编译器、不同优化等级下需调整循环次数。
 * ================================================================== */
void Delay_ms(uint32_t ms)
{
    /* i: 毫秒级外层循环计数器
     * j: 微秒级内层循环计数器（产生约1ms延时的空循环）
     */
    uint32_t i, j;

    /* 外层循环: 执行ms次，每次产生约1ms的延时 */
    for(i = 0; i < ms; i++)
    {
        /* 内层循环: 执行空操作约10000次，消耗约1ms时间
         * 10000这个值是经验值，在72MHz系统时钟下约等于1ms。
         * 如果实际延时不准，可调整此数字。
         */
        for(j = 0; j < 10000; j++)
        {
            /* 空操作，仅消耗CPU周期 */;
        }
    }
}
